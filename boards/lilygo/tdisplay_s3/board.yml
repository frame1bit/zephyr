## boards/lilygo/tdisplay_s3/board.yml
```yaml
board:
  name: tdisplay_s3
  full_name: T-Display S3
  vendor: lilygo
  socs:
  - name: esp32s3
```

## boards/st/stm32wba65i_dk1/board.yml
```yaml
board:
  name: stm32wba65i_dk1
  full_name: WBA65 Discovery Kit 1
  vendor: st
  socs:
    - name: stm32wba65xx
```

## boards/st/stm32wba65i_dk1/stm32wba65i_dk1_defconfig
```kconfig
# SPDX-License-Identifier: Apache-2.0
# Copyright (c) 2025 STMicroelectronics

# Enable UART driver
CONFIG_SERIAL=y

# Enable GPIO
CONFIG_GPIO=y

# Enable clock
CONFIG_CLOCK_CONTROL=y

# Console
CONFIG_CONSOLE=y
CONFIG_UART_CONSOLE=y

# Enable MPU
CONFIG_ARM_MPU=y

# Enable HW stack protection
CONFIG_HW_STACK_PROTECTION=y

# Enable the internal SMPS regulator
CONFIG_POWER_SUPPLY_DIRECT_SMPS=y

CONFIG_SPI=y
CONFIG_DISPLAY=y
CONFIG_DISPLAY_LOG_LEVEL_INF=y
CONFIG_SSD1306=y
```
